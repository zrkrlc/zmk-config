## config/west.yml
```yaml
manifest:
  remotes:
    - name: zmkfirmware
      url-base: https://github.com/zmkfirmware
  projects:
    - name: zmk
      remote: zmkfirmware
      revision: 266227b5804f286ddc1c689af7bf3e33608e2861
      import: app/west.yml
  self:
    path: config
```
